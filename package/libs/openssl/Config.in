## package/libs/openssl/Config.in
```kconfig
if PACKAGE_libopenssl

config OPENSSL_WITH_EC
	bool
	default y
	prompt "Enable elliptic curve support"

config OPENSSL_WITH_EC2M
        bool
        depends on OPENSSL_WITH_EC
        prompt "Enable ec2m support"

config OPENSSL_WITH_DEPRECATED
	bool
	default y
	prompt "Include deprecated APIs (See help for a list of packages that need this)"
	help
		Since openssl 1.1.0 is not supported yet, packages requiring this
		option do not list it as a requirement.
		Packages requiring this right now:  hostapd, freeswitch-stable, freeswitch,
		python, python3, squid.

config OPENSSL_WITH_DTLS
	bool
	default y
	prompt "Enable DTLS support"

config OPENSSL_WITH_COMPRESSION
	bool
	default n
	prompt "Enable compression support"

config OPENSSL_WITH_PSK
	bool
	default y
	prompt "Enable PSK support"

config OPENSSL_WITH_CMS
	bool
	default n
	prompt "Enable CMS support"

config OPENSSL_WITH_SRP
	bool
	default y
	prompt "Enable SRP support"

config OPENSSL_WITH_IDEA
	bool
	default n
	prompt "Enable IDEA support"

config OPENSSL_WITH_CAMELLIA
	bool
	default n
	prompt "Enable Camellia support"

config OPENSSL_WITH_MDC2
	bool
	default n
	prompt "Enable MDC2 support"

config OPENSSL_WITH_WHIRLPOOL
	bool
	default n
	prompt "Enable Whirlpool support"

config OPENSSL_WITH_SEED
	bool
	default n
	prompt "Enable SEED support"

config OPENSSL_WITH_ARIA
        bool
        default n
        prompt "Enable ARIA support"

config OPENSSL_WITH_SM234
	bool
	default n
	prompt "Enable SM2/3/4 support"

config OPENSSL_WITH_GOST
	bool
	default y
	prompt "Enable GOST engine"

config OPENSSL_WITH_RC2
	bool
	default n
	prompt "Enable RC2 support"

config OPENSSL_WITH_ASYNC
	bool
	default n
	prompt "Enable asynchronous jobs support"

config OPENSSL_WITH_RFC3779
	bool
	default n
	prompt "Enable RFC3779 support (BGP)"

config OPENSSL_OPTIMIZE_SPEED
	bool
	default n
	prompt "Enable optimization for speed instead of size"

config OPENSSL_ENGINE
	bool "Enable engine support"
	help
		This enables alternative cryptography implementations,
		most commonly for interfacing with external crypto devices,
		or supporting new/alternative ciphers and digests.

config OPENSSL_ENGINE_DIGEST
	bool
	depends on OPENSSL_ENGINE_CRYPTO
	prompt "Digest acceleration support"

endif

config OPENSSL_ENGINE_CRYPTO
	bool
	select OPENSSL_ENGINE
	prompt "Acceleration support through /dev/crypto" if PACKAGE_libopenssl
```
